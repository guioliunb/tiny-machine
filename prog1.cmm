{
    a = 50;
    b = 0;
    do &
        a = a - 1;
        write a;
    & while (a > 0);
}
